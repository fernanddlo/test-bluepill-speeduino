/**
 * @file main.cpp
 * @brief ECU principal - STM32F103C8T6
 */

#include "STM32_specific.h"
#include "config.h"

#include "map.h"
#include "trigger.h"
#include "sensors.h"
#include "fuel_pump.h"
#include "injection.h"
#include "ignition.h"
#include "maps.h"
#include "serial_protocol.h"
#include "runtime_data.h"

#include <stdint.h>


// ============================================================
// GLOBAL ENGINE STATE
// ============================================================

volatile EngineState engine_state = ENGINE_OFF;


// ============================================================
// 10 ms scheduler flag
// ============================================================

volatile uint8_t ecu_10ms_flag = 0;


// ============================================================
// ECU INITIALIZATION
// ============================================================

static void ECU_Init(void)
{
    // --------------------------------------------------------
    // Trigger / RPM
    // --------------------------------------------------------

    RPM_Init();


    // --------------------------------------------------------
    // Sensors
    // --------------------------------------------------------

    Sensors_Init();


    // --------------------------------------------------------
    // Fuel pump
    // --------------------------------------------------------

    FuelPump_Init();


    // --------------------------------------------------------
    // Injection
    // --------------------------------------------------------

    Injection_Init();


    // --------------------------------------------------------
    // Ignition
    // --------------------------------------------------------

    Ignition_Init();


    // --------------------------------------------------------
    // Initial engine state
    // --------------------------------------------------------
    // --------------------------------------------------------
    // Runtime data
    // --------------------------------------------------------

    RuntimeData_Init();


    // --------------------------------------------------------
    // Serial / TunerStudio
    // --------------------------------------------------------

    Serial_Init();


    engine_state = ENGINE_OFF;
}


// ============================================================
// 10 ms ENGINE TASK
// ============================================================

static void ECU_Task_10ms(void)
{
    // --------------------------------------------------------
    // RPM / trigger
    // --------------------------------------------------------

    RPM_Process();

    uint32_t rpm = RPM_Get();


    // --------------------------------------------------------
    // Sensors
    // --------------------------------------------------------

    Sensors_ReadAll();

    float tps = Sensors_GetTPS();

    float map_kpa = Sensors_GetMAP();

    float load = MAP_ToLoad(map_kpa);


    // --------------------------------------------------------
    // Engine state
    // --------------------------------------------------------

    if (rpm == 0)
    {
        engine_state = ENGINE_OFF;
    }
    else if (rpm < MIN_RPM_FOR_RUNNING)
    {
        engine_state = ENGINE_CRANKING;
    }
    else
    {
        engine_state = ENGINE_RUNNING;
    }

    // --------------------------------------------------------
    // Runtime data
    // --------------------------------------------------------

    RuntimeData_Update(
        rpm,
        map_kpa,
        load,
        tps,
        engine_state
    );

    // --------------------------------------------------------
    // Fuel pump
    // --------------------------------------------------------

    FuelPump_Process(rpm);


    // --------------------------------------------------------
    // Injection
    // --------------------------------------------------------

    if (engine_state == ENGINE_RUNNING)
    {
        if (!Injection_IsEnabled())
        {
            Injection_Enable();
        }

        Injection_Process(
            rpm,
            load
        );
    }
    else
    {
        Injection_Disable();
    }


    // --------------------------------------------------------
    // Ignition
    // --------------------------------------------------------

    if (engine_state == ENGINE_RUNNING)
    {
        Ignition_Process(
            rpm,
            load
        );
    }
    else
    {
        Ignition_Disable();
    }


    // --------------------------------------------------------
    // Evita warning temporário
    // --------------------------------------------------------

    (void)tps;
}


// ============================================================
// MAIN
// ============================================================

int main(void)
{
    // --------------------------------------------------------
    // Hardware
    // --------------------------------------------------------

    STM32_Init();


    // --------------------------------------------------------
    // ECU modules
    // --------------------------------------------------------

    ECU_Init();


    // --------------------------------------------------------
    // Main loop
    // --------------------------------------------------------

    while (1)
    {
        if (ecu_10ms_flag)
        {
            ecu_10ms_flag = 0;

            ECU_Task_10ms();
        }
    }
}
